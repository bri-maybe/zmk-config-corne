## config/west.yml
```yaml
manifest:
  remotes:
    - name: bri-maybe
      url-base: https://github.com/bri-maybe
  projects:
    - name: zmk
      remote: bri-maybe
      revision: main
      import: app/west.yml
  self:
    path: config
```
