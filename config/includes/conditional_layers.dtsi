/ {

    conditional_layers {
        compatible = "zmk,conditional-layers";
        func_layer {
            if-layers = <SYM NUM>;
            then-layer = <FUNC>;
        };
        toggle_qwerty {
            layers = <BASE_QWERTY>;
            if-layers = <BASE_QWERTY>;
            then-layer = <BASE_WRKMN>;
        };
    };

};